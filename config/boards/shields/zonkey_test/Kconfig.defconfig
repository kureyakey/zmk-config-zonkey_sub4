## config/boards/shields/zonkey_test/Kconfig.defconfig
```kconfig
if SHIELD_ZONKEYTEST_R

config ZMK_KEYBOARD_NAME
    default "zonkeytest_R"

config ZMK_SPLIT
    default y

config ZMK_SPLIT_ROLE_CENTRAL
    default y

endif

if SHIELD_ZONKEYTEST_L

config ZMK_KEYBOARD_NAME
    default "zonkeytest_L"

config ZMK_SPLIT
    default y

endif
```

## config/boards/shields/zonkey_test/Kconfig.shield
```kconfig
config SHIELD_ZONKEY_TEST_L
    def_bool $(shields_list_contains,zonkey_test_L)

config SHIELD_ZONKEY_TEST_R
    def_bool $(shields_list_contains,zonkey_test_R)
```

## config/boards/shields/zonkeytest/Kconfig.shield
```kconfig
config SHIELD_ZONKEYTEST_L
    def_bool $(shields_list_contains,zonkeytest_L)

config SHIELD_ZONKEYTEST_R
    def_bool $(shields_list_contains,zonkeytest_R)
```

## config/west.yml
```yaml
manifest:
  remotes:
    - name: zmkfirmware
      url-base: https://github.com/zmkfirmware
    - name: petejohanson
      url-base: https://github.com/petejohanson
    - name: caksoylar  # <-- new entry
      url-base: https://github.com/caksoylar  
  projects:
    - name: zmk
      remote: zmkfirmware
      revision: v0.3
      import: app/west.yml
    - name: zmk-input-behavior-listener
      remote: petejohanson
      revision: main
    - name: zmk-rgbled-widget  # <-- new entry
      remote: caksoylar
      revision: main
  self:
    path: config
```
